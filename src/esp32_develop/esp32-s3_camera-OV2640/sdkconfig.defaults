## src/esp32_develop/esp32_camera_firmware/main/Kconfig.projbuild
```kconfig
menu "Camera Configuration"

    config ESP_WIFI_SSID
        string "WiFi SSID"
        default "myssid"
        help
            SSID (network name) for the example to connect to.

    config ESP_WIFI_PASSWORD
        string "WiFi Password"
        default "mypassword"
        help
            WiFi password (WPA or WPA2) for the example to connect to.

    config ESP_MAXIMUM_RETRY
        int "Maximum retry"
        default 5
        help
            Maximum number of retries when connecting to WiFi.

    config LED_GPIO
        int "Flash LED GPIO"
        default 4
        help
            GPIO number for the high-power Flash LED.

    config LED_STATUS_GPIO
        int "Status LED GPIO"
        default 33
        help
            GPIO number for the status LED (usually red, active low).

endmenu
```

## src/esp32_develop/esp32cam_app/esp32_firmware/esp32_camera_firmware/sdkconfig.defaults
```kconfig
CONFIG_ESPTOOLPY_FLASHSIZE_4MB=y
CONFIG_ESP32_SPIRAM_SUPPORT=y
CONFIG_SPIRAM_USE_MALLOC=y
CONFIG_ESP_MAIN_TASK_STACK_SIZE=8192
CONFIG_HTTPD_MAX_REQ_HDR_LEN=1024
CONFIG_HTTPD_MAX_URI_LEN=1024
CONFIG_ESP_WIFI_SSID="CU_204"
CONFIG_ESP_WIFI_PASSWORD="wj990518."
```
