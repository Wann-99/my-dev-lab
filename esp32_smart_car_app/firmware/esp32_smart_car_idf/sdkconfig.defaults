## esp32_smart_car_app/firmware/esp32_smart_car_idf/sdkconfig.defaults
```kconfig
CONFIG_HTTPD_WS_SUPPORT=y

# Partition Table Config
CONFIG_PARTITION_TABLE_CUSTOM=y
CONFIG_PARTITION_TABLE_CUSTOM_FILENAME="partitions.csv"
CONFIG_PARTITION_TABLE_OFFSET=0x8000

# Save IRAM space (Aggressive Optimization)
CONFIG_ESP_WIFI_IRAM_OPT=n
CONFIG_ESP_WIFI_RX_IRAM_OPT=n
CONFIG_FREERTOS_PLACE_FUNCTIONS_INTO_FLASH=y
CONFIG_RINGBUF_PLACE_FUNCTIONS_INTO_FLASH=y
CONFIG_ESP_EVENT_POST_FROM_ISR=n
CONFIG_SPI_FLASH_ROM_DRIVER_PATCH=y

# N16R8 Module Config
CONFIG_ESPTOOLPY_FLASHSIZE_16MB=y
# Fix: ESP-IDF v5.x uses generic CONFIG_SPIRAM
CONFIG_SPIRAM=y
CONFIG_SPIRAM_MODE_OCT=y
CONFIG_SPIRAM_SPEED_80M=y
```

## src/esp32_develop/esp32_camera_firmware/sdkconfig.defaults
```kconfig
# Core settings for ESP32-S3 N16R8
CONFIG_IDF_TARGET="esp32s3"

# Flash settings (16MB OPI)
CONFIG_ESPTOOLPY_FLASHSIZE_16MB=y
CONFIG_ESPTOOLPY_FLASHMODE_OPI=y
CONFIG_ESPTOOLPY_FLASHFREQ_80M=y

# PSRAM settings (8MB OPI)
CONFIG_SPIRAM=y
CONFIG_SPIRAM_MODE_OCT=y
CONFIG_SPIRAM_TYPE_AUTO=y
CONFIG_SPIRAM_BOOT_INIT=y
CONFIG_SPIRAM_SPEED_80M=y

# Camera and Framebuffer optimization
CONFIG_ESP32_DEFAULT_CPU_FREQ_240=y
CONFIG_MEMMAP_SMP=y

# USB Console and Debugging
CONFIG_ESP_CONSOLE_USB_SERIAL_JTAG=y
CONFIG_ESP_CONSOLE_UART_DEFAULT=n
CONFIG_ESP_CONSOLE_SECONDARY_NONE=y

# Power Stability Optimization
# Set brownout threshold to a lower level (approx 2.5V) to handle camera peak currents
CONFIG_ESP_BROWNOUT_DET=y
CONFIG_ESP_BROWNOUT_DET_LVL_SEL_0=y

CONFIG_ESP32S3_DEFAULT_CPU_FREQ_240=y
CONFIG_SPIRAM_USE_MALLOC=y
CONFIG_SPIRAM_ALLOW_STACK_EXTERNAL_MEMORY=y
CONFIG_CAMERA_OV2640_SUPPORT=y
```

## src/esp32_develop/esp32_s3_heart_rate/sdkconfig.defaults
```kconfig
CONFIG_BT_ENABLED=y
CONFIG_BT_BLE_ENABLED=y
CONFIG_BT_BLUEDROID_ENABLED=y
CONFIG_BT_CLASSIC_ENABLED=n
CONFIG_GATTC_ENABLE=y
CONFIG_GATTS_ENABLE=y
CONFIG_BLE_SMP_ENABLE=y
```

## src/esp32_develop/esp32_smart_car_app/firmware/esp32_smart_car_idf/sdkconfig.defaults
```kconfig
CONFIG_HTTPD_WS_SUPPORT=y

# Partition Table Config
CONFIG_PARTITION_TABLE_CUSTOM=y
CONFIG_PARTITION_TABLE_CUSTOM_FILENAME="partitions.csv"
CONFIG_PARTITION_TABLE_OFFSET=0x8000

# Save IRAM space (Aggressive Optimization)
CONFIG_ESP_WIFI_IRAM_OPT=n
CONFIG_ESP_WIFI_RX_IRAM_OPT=n
CONFIG_FREERTOS_PLACE_FUNCTIONS_INTO_FLASH=y
CONFIG_RINGBUF_PLACE_FUNCTIONS_INTO_FLASH=y
CONFIG_ESP_EVENT_POST_FROM_ISR=n
CONFIG_SPI_FLASH_ROM_DRIVER_PATCH=y

# N16R8 Module Config
CONFIG_ESPTOOLPY_FLASHSIZE_16MB=y
# Fix: ESP-IDF v5.x uses generic CONFIG_SPIRAM
CONFIG_SPIRAM=y
CONFIG_SPIRAM_MODE_OCT=y
CONFIG_SPIRAM_SPEED_80M=y

# Increase system event task stack size to prevent overflow (especially with mDNS)
CONFIG_ESP_SYSTEM_EVENT_TASK_STACK_SIZE=4096

# HTTP Server Optimization
CONFIG_HTTPD_MAX_REQ_HDR_LEN=1024
CONFIG_HTTPD_MAX_URI_LEN=1024
CONFIG_HTTPD_ERR_RESP_NO_DELAY=y
CONFIG_HTTPD_PURGE_BUF_LEN=32

# LwIP & Sockets
CONFIG_LWIP_MAX_SOCKETS=16
CONFIG_LWIP_TCP_MSL=60000
CONFIG_HTTPD_MAX_OPEN_SOCKETS=13
```

## src/esp32_develop/esp32_smart_car_app/firmware/esp32_smart_car_idf_bak/main/Kconfig.projbuild
```kconfig
menu "Smart Car Configuration"

    config ESP_WIFI_SSID
        string "WiFi SSID"
        default "Tenda_WLAN"

    config ESP_WIFI_PASSWORD
        string "WiFi Password"
        default "Wj_990518."

    config ESP_MAXIMUM_RETRY
        int "Maximum retry"
        default 5

endmenu
```

## src/esp32_develop/esp32_smart_car_app/firmware/sdkconfig.defaults
```kconfig
# ESP32-S3 N16R8 Configuration
CONFIG_IDF_TARGET="esp32s3"

# Flash Size 16MB
CONFIG_ESPTOOLPY_FLASHSIZE_16MB=y
CONFIG_ESPTOOLPY_FLASHSIZE="16MB"

# PSRAM Configuration (Octal for N16R8)
CONFIG_SPIRAM=y
CONFIG_SPIRAM_MODE_OCT=y
CONFIG_SPIRAM_SPEED_80M=y

# Partition Table
CONFIG_PARTITION_TABLE_CUSTOM=y
CONFIG_PARTITION_TABLE_CUSTOM_FILENAME="partitions.csv"

# FreeRTOS
CONFIG_FREERTOS_HZ=1000

# Compiler options
CONFIG_COMPILER_OPTIMIZATION_PERF=y

# HTTP Server & WebSocket
CONFIG_HTTPD_WS_SUPPORT=y
```
